#include "kiwi-v3.dtsi"

&default_transform { // The matrix transform for this board is 6 columns over because the left half is 6 columns wide according to the matrix.
	col-offset = <6>;
};

&kscan0 {
	col-gpios
		= <&pro_micro 19 GPIO_ACTIVE_HIGH> // col12
		, <&pro_micro 18 GPIO_ACTIVE_HIGH> // col11
		, <&pro_micro 15 GPIO_ACTIVE_HIGH> // col10
		, <&pro_micro 14 GPIO_ACTIVE_HIGH> // col09
		, <&pro_micro 16 GPIO_ACTIVE_HIGH> // col08
		, <&pro_micro 10 GPIO_ACTIVE_HIGH> // col07
	;
	row-gpios
        	= <&pro_micro 4 GPIO_ACTIVE_HIGH | GPIO_PULL_DOWN> // row3
        	, <&pro_micro 5 GPIO_ACTIVE_HIGH | GPIO_PULL_DOWN> // row2
        	, <&pro_micro 6 GPIO_ACTIVE_HIGH | GPIO_PULL_DOWN> // row1
	;
};
