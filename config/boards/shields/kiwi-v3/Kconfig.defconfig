## config/boards/shields/kiwi-v3/Kconfig.defconfig
```kconfig
if SHIELD_KIWI-V3_LEFT

config ZMK_KEYBOARD_NAME
    default "kiwi-v3"

config ZMK_SPLIT_BLE_ROLE_CENTRAL
    default y

endif

if SHIELD_KIWI-V3_LEFT || SHIELD_KIWI-V3_RIGHT

config ZMK_SPLIT
    default y
endif
```

## config/boards/shields/kiwi-v3/kconfig.shield
```kconfig
config SHIELD_KIWI-V3_LEFT
	def_bool $(shields_list_contains,kiwi-v3_left)

config SHIELD_KIWI-V3_RIGHT
	def_bool $(shields_list_contains,kiwi-v3_right)
```
